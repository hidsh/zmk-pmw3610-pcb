## boards/shields/pmw3610-pcb/Kconfig.defconfig
```kconfig
if SHIELD_PMW3610_PCB

    config ZMK_KEYBOARD_NAME
        default "PMW3610-PCB"

    config ZMK_BLE
        bool
        default y

endif
```

## boards/shields/pmw3610-pcb/Kconfig.shield
```kconfig
# No whitespace after the comma or in your keyboard name!
config SHIELD_PMW3610_PCB
    def_bool $(shields_list_contains,pmw3610_pcb)
```
